## conf/distro/gbeos.conf
```bitbake
DISTRO = "gbeos"
DISTRO_NAME = "GreatBear Edge OS Distro"
DISTRO_VERSION = "1.0-rc0"
DISTRO_CODENAME = "alcor"

LICENSE_FLAGS_ACCEPTED += "commercial"

MAINTAINER = "Fabien Andrieux <fandrieu@cisco.com>"

GB_DEFAULT_DISTRO_FEATURES = "ptest systemd pam virtualization security k3s opengl x11"

DISTRO_FEATURES ?= "${DISTRO_FEATURES_DEFAULT} ${GB_DEFAULT_DISTRO_FEATURES}"

PACKAGE_CLASSES ?= "package_deb"

VIRTUAL-RUNTIME_graphical_init_manager = ""
INIT_MANAGER = "systemd"

DISTRO_FEATURES:append = " systemd seccomp bash"
DISTRO_FEATURES_BACKFILL_CONSIDERED:append = " sysvinit"
VIRTUAL-RUNTIME_init_manager = "systemd"
VIRTUAL-RUNTIME_initscripts = "systemd-compat-units"
VIRTUAL-RUNTIME_login_manager = "shadow-base"
VIRTUAL-RUNTIME_dev_manager = "systemd"


require conf/distro/include/yocto-uninative.inc
require conf/distro/include/init-manager-systemd.inc
require conf/distro/include/no-static-libs.inc

INHERIT += "uninative"
```
